## kernel/kernel_device_modules-6.12/drivers/misc/Kconfig
```kconfig
# SPDX-License-Identifier: GPL-2.0-only

source "drivers/misc/mediatek/Kconfig"

source "drivers/misc/huaqin/Kconfig"

# Tab A9 code for SR-AX6739A-01-392 by gaochao at 20230426 start
source "drivers/misc/grdm/Kconfig"
source "drivers/misc/KnoxVault/Kconfig"
source "drivers/misc/KnoxVaultDev/Kconfig"
# Tab A9 code for SR-AX6739A-01-392 by gaochao at 20230426 end
```

## kernel/kernel_device_modules-6.12/drivers/misc/huaqin/Kconfig
```kconfig
#
# for huaqin misc info
#

# Tab A9_BOS code for AX6739W-11 by Liushiyuan at 20250607 start
config HQ_SIM_TRAY_CHECK
	tristate "check sim stry status"
        default y
	help
	  this will create a node to show sim tray status.

	  If unsure, say N.
# Tab A9_BOS code for AX6739W-11 by Liushiyuan at 20250607 end
# Tab A9 code for SR-AX6739A-01-371 by tangyuhang at 20230526 start
config TRIGGER_CRASH_BY_KEY
  	tristate "Enable trigger crash by keys"
	  help
	    You can trigger crash by pressing keys in strict order:
	    VOLUMEUP twice + VOLUMEDOWN twice + POWER twice.
# Tab A9 code for SR-AX6739A-01-371 by tangyuhang at 20230526 end

config HPERF_ENABLE
    tristate "regulatore control of hperf"
    help
      Say m here if you have a hperf.
      If unsure, say N.
```
