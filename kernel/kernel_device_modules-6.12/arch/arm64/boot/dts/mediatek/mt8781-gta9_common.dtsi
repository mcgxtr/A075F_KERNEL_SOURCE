/* Generated by Samsung for MTK vendor board 

 * If these files should be changed, then please make a sync with MTK
*/

/ {
	fragment@model {
		target-path = "/";
		__overlay__ {
			usb_notifier {
				compatible = "samsung,usb-notifier";
				status = "okay";
				disable_host_wakelock;
			};
			ufs-sec-driver {
				compatible = "samsung,ufs-sec-driver";
				status = "okay";
			};			
		};
	};
};