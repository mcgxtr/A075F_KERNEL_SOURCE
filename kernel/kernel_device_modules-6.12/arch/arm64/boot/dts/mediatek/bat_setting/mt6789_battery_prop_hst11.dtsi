// SPDX-License-Identifier: GPL-2.0
/*
 * Copyright (c) 2021 MediaTek Inc.
 * Author: Wy Chuang<wy.chuang@mediatek.com>
 *
 */

&mtk_gauge {
	DIFFERENCE_FULLOCV_ITH = <(200)>;
	/* Charging termination current */
	SHUTDOWN_1_TIME = <(5)>;
	/* If ui_soc shows 1% more than X minites, system will shutdown */
	KEEP_100_PERCENT = <(1)>;
	R_FG_VALUE = <(5)>;
	/* R_sense resistance */
	EMBEDDED_SEL = <(0)>;
	/* Configures whether using embedded battery or not */
	PMIC_SHUTDOWN_CURRENT = <(20)>;
	/* System shutdown current */
	FG_METER_RESISTANCE = <(70)>;
	/* The resistance of PCB */
	/*Tab A9 code for SR-AX6739A-01-460 by lina at 20230519 start*/
	CAR_TUNE_VALUE = <(99)>;
	/* Tune value for current measurement */
	/*Tab A9 code for SR-AX6739A-01-460 by lina at 20230519 end*/
	PMIC_MIN_VOL = <(33500)>;
	/* vboot voltage for gauge 0%*/
	POWERON_SYSTEM_IBOOT = <(500)>;
	/* power on system iboot */
	SHUTDOWN_GAUGE0_VOLTAGE = <(34000)>;
	/* shutdown gauge 0% voltage */
	TEMPERATURE_T0 = <(50)>;
	/* Battery temperature T0 */
	TEMPERATURE_T1 = <(25)>;
	/* Battery temperature T1 */
	TEMPERATURE_T2 = <(10)>;
	/* Battery temperature T2 */
	TEMPERATURE_T3 = <(0)>;
	/* Battery temperature T3 */
	/*Tab A9 code for SR-AX6739A-01-515 by lina at 20230505 start*/
	TEMPERATURE_T4 = <(-10)>;
	/* Battery temperature T4 */
	TEMPERATURE_T5 = <(-20)>;
	/*Tab A9 code for SR-AX6739A-01-515 by lina at 20230505 end*/
	/* Battery temperature T5 */
	g_FG_PSEUDO100_T0 = <(100)>;
	/* Pseudo 100% percentage at T0 */
	g_FG_PSEUDO100_T1 = <(100)>;
	/* Pseudo 100% percentage at T1 */
	g_FG_PSEUDO100_T2 = <(100)>;
	/* Pseudo 100% percentage at T2 */
	g_FG_PSEUDO100_T3 = <(100)>;
	/* Pseudo 100% percentage at T3 */
	g_FG_PSEUDO100_T4 = <(100)>;
	/* Pseudo 100% percentage at T4 */
	Q_MAX_SYS_VOLTAGE_BAT0 = <(3350)>;
	/* Pseudo1 for hide percentage */
	Q_MAX_SYS_VOLTAGE_BAT1 = <(3350)>;
	/* Pseudo1 for hide percentage */
	Q_MAX_SYS_VOLTAGE_BAT2 = <(3350)>;
	/* Pseudo1 for hide percentage */
	Q_MAX_SYS_VOLTAGE_BAT3 = <(3350)>;
	/* Pseudo1 for hide percentage */
	COM_FG_METER_RESISTANCE = <(100)>;
	/* compensate The resistance of PCB */
	COM_R_FG_VALUE = <(0)>;
	/* compensate R_sense resistance */
	enable_tmp_intr_suspend = <(0)>;
	/* Enable update temp when suspend */
	ACTIVE_TABLE = <(6)>;
	/* Table numbers per battery */
	MULTI_TEMP_GAUGE0 = <(1)>;
	/* Multi gauge0 enable */
	/* Tab A11 code for AL7761C-1 by qinzhangchao at 20250821 start */
	BATTERY_SHUTDOWN_TEMPERATURE = <(59)>;
	/* Tab A11 code for AL7761C-1 by qinzhangchao at 20250821 end */
	RBAT_PULL_UP_VOLT = <(2800)>;
	/* HST11 code for AX7800A-788|AX7800A-2341 by wenyaqi at 20250618 start */
	CHARGE_PSEUDO_FULL_LEVEL = <(6500)>;
	/* HST11 code for AX7800A-788|AX7800A-2341 by wenyaqi at 20250618 end */
	/* HST11 code for AX7800A-4111 by wenyaqi at 20250723 start */
	RBAT_PULL_UP_R = <(390000)>;
	Fg_Temperature_Table_ODM =
	<
		(-40) 4397100
		(-35) 3088600
		(-30) 2197200
		(-25) 1581880
		(-20) 1151040
		(-15) 846580
		(-10) 628990
		(-5) 471630
		(0) 357010
		5 272500
		10 209710
		15 162650
		20 127080
		25 100000
		30 79222
		35 63167
		40 50677
		45 40904
		50 33195
		55 27091
		60 22224
	>;
	/* HST11 code for AX7800A-4111 by wenyaqi at 20250723 end */
#include "mt6789_battery_table_ext_hst11.dtsi"
#include "mt6789_battery_prop_dim2_ext_hst11.dtsi"
};
